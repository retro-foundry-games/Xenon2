/* Generated by tools/gen_symbols.py: do not edit.  The code is one hunk linked at the address it will run at (BASE, above the
 * original's memory), so it needs no relocation; the variables and tables are absolute: they are where the original keeps them. */
SECTIONS {
    .text 0xc0000 : { *(.text .text.*) *(.rodata .rodata.*) *(.data .data.*) }
    /DISCARD/ : { *(.comment) *(.note*) *(.eh_frame*) }
}
_random_a = 0x1fee;
_random_b = 0x1ff2;
